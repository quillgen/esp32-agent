## main/Kconfig.projbuild
```kconfig
menu "🤖 AGENT configuration"

    orsource "$IDF_PATH/examples/common_components/env_caps/$IDF_TARGET/Kconfig.env_caps"
    config BLINK_GPIO
        int "RGB LED GPIO number"
        range ENV_GPIO_RANGE_MIN ENV_GPIO_OUT_RANGE_MAX
        default 48
        help
            GPIO number (IOxx) of RGB led.
    config AGENT_PLAY_BOOT_SOUND
        bool "Play demo sound on boot"
        default n
        help
            Play hardcoded WAV files from SPIFFS at startup (development aid).
    config ESP_WIFI_SSID
        string "WiFi SSID"
        default "ChinaNet-uvZD"
        help
            SSID (network name).
    config ESP_WIFI_PASSWORD
        string "WiFi Password"
        default "fake-password"
        help
            WiFi password (WPA or WPA2).
endmenu
```
